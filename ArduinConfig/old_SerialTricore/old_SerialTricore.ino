/*** Firmware for HIMS ver 1.0 ***/

/* LMU uninitialised data */
StartOfUninitialised_LMURam_Variables
EndOfUninitialised_LMURam_Variables
/* LMU uninitialised data */
StartOfInitialised_LMURam_Variables
static const uint8_t hdm[] = { 0, 0, 0, 0, 0, 0, 0, 0, 0, 0, 0, 0, 1,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 1, 1 };
EndOfInitialised_LMURam_Variables
/*** Core 0 ***/
void setup() {
}
void loop() {
  // core 0 unused
}


/*** Core 1 ***/

/* CPU1 Uninitialised Data */
StartOfUninitialised_CPU1_Variables
int VADC_result[4096];
EndOfUninitialised_CPU1_Variables

/* CPU1 Initialised Data */
StartOfInitialised_CPU1_Variables
uint32_t lastPulseus = 0;
uint32_t us = 0;
//Hadamard sequence 4096 points
const int hdmN = 4095;
int VADCn = 0;
uint32_t pulseWidth = 15;
int driftcode = 0; //0 Hadamard, 1-9 pulse width
EndOfInitialised_CPU1_Variables

void setup1() {
  pinMode(13, OUTPUT);
  pinMode(12, OUTPUT);
  pinMode(11, OUTPUT);
  analogReadResolution(12);
}


void loop1() {
  for (int i = 0; i < hdmN; i++) //80ns
  {
    
    if (driftcode == 9)
    {
      Fast_digitalWrite(13, 0); // 70ns  start with 0 for 20% of the pulse us
      delayMicroseconds(pulseWidth / 5);
      Fast_digitalWrite(13, hdm[i]);
    }
    //without chopped
    do {
      us = micros();
    } while (us - lastPulseus < pulseWidth);
    if (driftcode == 0)
      Fast_digitalWrite(13, hdm[i]); // 70ns
    if (driftcode > 0 && driftcode < 9) // 1-8
      Fast_digitalWrite(13, (i < (driftcode * 2))); // 70ns v. 1.2 added *2

                           //Fast_digitalWrite(11, hdm[(i + hdmN - 1000) % hdmN]); // 70ns  //simulate delayed pulse on pin 11
    delayMicroseconds(1);
    lastPulseus = us;
    VADC_result[i] += ReadAD0(); //2800 ns
  }
  VADCn++;
}



/*** Core 2 ***/

/* CPU2 Uninitialised Data */
StartOfUninitialised_CPU2_Variables
int VADC_buffer[4096];
int VADCnbuffer;
EndOfUninitialised_CPU2_Variables

/* CPU2 Initialised Data */
StartOfInitialised_CPU2_Variables
int i = 0;
EndOfInitialised_CPU2_Variables

void setup2() {
  SerialASC.begin(2000000);
  printData();
}

void loop2() {
  if (SerialASC.available() > 0)
  {
    char ch = SerialASC.read();//one char
    driftcode = ch - '0';
    ch = SerialASC.read();//second char
    pulseWidth = (ch - '0') * 5;
    printData();
  }
}

void printlnHex(int num) {
  char tmp[16];
  sprintf(tmp, "%06X", num & 0xFFFFFF);
  SerialASC.println(tmp);
}

void printData() {
  printlnHex(driftcode * 16 + pulseWidth / 5);

  SerialASC.println("______");
  //copy the acquired data to a buffer
  for (int i = 0; i < hdmN; i++)
  {
    VADC_buffer[i] = VADC_result[i];
    VADC_result[i] = 0;
  }
  VADCnbuffer = VADCn;
  VADCn = 0;

  //print the buffer to the serial port
  for (int i = 0; i < hdmN; i++)
  {
    printlnHex(VADC_buffer[i]);
  }
  SerialASC.println("......");
  printlnHex(VADCnbuffer);
}



